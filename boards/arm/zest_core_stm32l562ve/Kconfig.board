## boards/arm/zest_core_stm32l562ve/Kconfig.board
```kconfig
# Zest Core STM32L4A6RG board configuration

# Copyright (c) 2024 CATIE
# SPDX-License-Identifier: Apache-2.0

config BOARD_ZEST_CORE_STM32L562VE
	bool "Zest Core STM32L562VE Development Board"
	depends on SOC_STM32L562XX
```

## boards/arm/zest_core_stm32l562ve/Kconfig.defconfig
```kconfig
# Zest Core STM32L562VE board configuration

# Copyright (c) 2024 CATIE
# SPDX-License-Identifier: Apache-2.0

if BOARD_ZEST_CORE_STM32L562VE

config BOARD
	default "zest_core_stm32l562ve"

endif # BOARD_ZEST_CORE_STM32L562VE
```

## boards/arm/zest_core_stm32l562ve/zest_core_stm32l562ve_defconfig
```kconfig
# Copyright (c) 2024 CATIE
# SPDX-License-Identifier: Apache-2.0

CONFIG_SOC_SERIES_STM32L5X=y
CONFIG_SOC_STM32L562XX=y

# enable uart driver
CONFIG_SERIAL=y

# enable GPIO
CONFIG_GPIO=y

# Enable Clocks
CONFIG_CLOCK_CONTROL=y

# console
CONFIG_CONSOLE=y
CONFIG_UART_CONSOLE=y

# enable MPU
CONFIG_ARM_MPU=y

# enable pin controller
CONFIG_PINCTRL=y
```

## boards/catie/zest_core_stm32l562ve/Kconfig.zest_core_stm32l562ve
```kconfig
# Copyright (c) 2024 CATIE
# SPDX-License-Identifier: Apache-2.0

config BOARD_ZEST_CORE_STM32L562VE
	select SOC_STM32L562XX
```
